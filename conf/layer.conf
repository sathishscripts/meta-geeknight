## conf/layer.conf
```bitbake
# We have a conf and classes directory, add to BBPATH
BBPATH .= ":${LAYERDIR}"

# We have recipes-* directories, add to BBFILES
BBFILES += "${LAYERDIR}/recipes-*/*/*.bb \
            ${LAYERDIR}/recipes-*/*/*.bbappend"

BBFILE_COLLECTIONS += "meta-geeknight"
BBFILE_PATTERN_meta-geeknight = "^${LAYERDIR}/"
BBFILE_PRIORITY_meta-geeknight = "10"

LAYERSERIES_COMPAT_meta-geeknight = "sumo"
LAYERDEPENDS_meta-geeknight = " qt5-layer"
```
